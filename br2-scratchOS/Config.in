## br2-scratchOS/Config.in
```kconfig
menu "Template Platform "

menu "Applications"

    menu "DHS Unit Testing"

    endmenu

    menu "Regression Unit Testing"

    endmenu

    menu "TPL ATP"
        menu "Ruby Runtime Environment"

        endmenu
    endmenu

endmenu


menu "TPL Drivers"

    menu "Kernel space"

    endmenu

    menu "User space"

    endmenu

endmenu

endmenu
```

## br2-scratchOS/configs/raspberrypi3_64_defconfig
```kconfig
BR2_aarch64=y
BR2_TOOLCHAIN_EXTERNAL=y
BR2_TARGET_GENERIC_HOSTNAME="remblerOS"
BR2_TARGET_GENERIC_ISSUE="Core Real-Time Executive Software System For Multiprocessor"
BR2_TARGET_GENERIC_PASSWD_SHA512=y
BR2_INIT_SYSTEMD=y
BR2_TARGET_GENERIC_GETTY_PORT="ttyAMA0"
BR2_TARGET_GENERIC_GETTY_BAUDRATE_115200=y
BR2_SYSTEM_DHCP="eth0"
BR2_SYSTEM_DEFAULT_PATH="/bin:/sbin:/usr/bin:/usr/sbin"
BR2_GENERATE_LOCALE="en_US"
BR2_SYSTEM_ENABLE_NLS=y
BR2_TARGET_TZ_ZONELIST="europe"
BR2_TARGET_LOCALTIME="Europe/Paris"
BR2_ROOTFS_USERS_TABLES="$(BR2_EXTERNAL_SCRATCHOS_PATH)/board/common/cfsboard.user.cfg"
BR2_ROOTFS_POST_BUILD_SCRIPT="$(BR2_EXTERNAL_SCRATCHOS_PATH)/board/raspberrypi3-64/post-build.sh"
BR2_ROOTFS_POST_IMAGE_SCRIPT="$(BR2_EXTERNAL_SCRATCHOS_PATH)/board/raspberrypi3-64/post-image.sh"
BR2_LINUX_KERNEL=y
BR2_LINUX_KERNEL_CUSTOM_TARBALL=y
BR2_LINUX_KERNEL_CUSTOM_TARBALL_LOCATION="$(call github,raspberrypi,linux,655fc658a15ae7a6f37103754adb39ba52a9a14e)/linux-655fc658a15ae7a6f37103754adb39ba52a9a14e.tar.gz"
BR2_LINUX_KERNEL_PATCH="$(BR2_EXTERNAL_SCRATCHOS_PATH)/patches/linux"
BR2_LINUX_KERNEL_USE_CUSTOM_CONFIG=y
BR2_LINUX_KERNEL_CUSTOM_CONFIG_FILE="$(BR2_EXTERNAL_SCRATCHOS_PATH)/board/raspberrypi3-64/configs/linux.config"
BR2_LINUX_KERNEL_DTS_SUPPORT=y
BR2_LINUX_KERNEL_INTREE_DTS_NAME="broadcom/bcm2710-rpi-3-b broadcom/bcm2710-rpi-3-b-plus broadcom/bcm2837-rpi-3-b"
BR2_LINUX_KERNEL_NEEDS_HOST_OPENSSL=y
BR2_PACKAGE_BUSYBOX_CONFIG="$(BR2_EXTERNAL_SCRATCHOS_PATH)/board/raspberrypi3-64/configs/busybox.config"
BR2_PACKAGE_MMC_UTILS=y
BR2_PACKAGE_RPI_FIRMWARE=y
BR2_PACKAGE_RPI_FIRMWARE_BOOTCODE_BIN=y
BR2_PACKAGE_RPI_FIRMWARE_VARIANT_PI=y
BR2_PACKAGE_RPI_FIRMWARE_CONFIG_FILE="$(BR2_EXTERNAL_SCRATCHOS_PATH)/board/raspberrypi3-64/config_3_64bit.txt"
BR2_PACKAGE_RPI_FIRMWARE_CMDLINE_FILE="$(BR2_EXTERNAL_SCRATCHOS_PATH)/board/raspberrypi3-64/cmdline.txt"
BR2_PACKAGE_XML_SECURITY_C=y
BR2_PACKAGE_BOOST=y
BR2_PACKAGE_BOOST_DATE_TIME=y
BR2_PACKAGE_BOOST_PROGRAM_OPTIONS=y
BR2_PACKAGE_BOOST_REGEX=y
BR2_PACKAGE_BOOST_THREAD=y
BR2_PACKAGE_GTEST=y
BR2_PACKAGE_GTEST_GMOCK=y
BR2_PACKAGE_LIBESMTP=y
BR2_PACKAGE_ATOP=y
BR2_PACKAGE_HTOP=y
BR2_PACKAGE_SYSTEMD_FIRSTBOOT=y
BR2_PACKAGE_SYSTEMD_OOMD=y
BR2_PACKAGE_SYSTEMD_REPART=y
BR2_TARGET_ROOTFS_INITRAMFS=y
# BR2_TARGET_ROOTFS_TAR is not set
BR2_TARGET_UBOOT=y
BR2_TARGET_UBOOT_BUILD_SYSTEM_KCONFIG=y
BR2_TARGET_UBOOT_CUSTOM_TARBALL=y
BR2_TARGET_UBOOT_CUSTOM_TARBALL_LOCATION="$(call github,u-boot,u-boot,252592214f79d8206c3cf0056a8827a0010214e0)/u-boot-252592214f79d8206c3cf0056a8827a0010214e0.tar.gz"
BR2_TARGET_UBOOT_USE_CUSTOM_CONFIG=y
BR2_TARGET_UBOOT_CUSTOM_CONFIG_FILE="$(BR2_EXTERNAL_SCRATCHOS_PATH)/board/raspberrypi3-64/configs/uboot.config"
BR2_PACKAGE_HOST_DOS2UNIX=y
BR2_PACKAGE_HOST_DOSFSTOOLS=y
BR2_PACKAGE_HOST_DOXYGEN=y
BR2_PACKAGE_HOST_DTC=y
BR2_PACKAGE_HOST_E2FSPROGS=y
BR2_PACKAGE_HOST_GENIMAGE=y
BR2_PACKAGE_HOST_GNUPG=y
BR2_PACKAGE_HOST_JQ=y
BR2_PACKAGE_HOST_MTD=y
BR2_PACKAGE_HOST_MTOOLS=y
BR2_PACKAGE_HOST_RAUC=y
BR2_PACKAGE_HOST_UBOOT_TOOLS=y
BR2_PACKAGE_HOST_UBOOT_TOOLS_ENVIMAGE=y
BR2_PACKAGE_HOST_UBOOT_TOOLS_ENVIMAGE_SOURCE="$(BR2_EXTERNAL_SCRATCHOS_PATH)/board/raspberrypi3-64/uboot.env.txt"
BR2_PACKAGE_HOST_UBOOT_TOOLS_ENVIMAGE_SIZE="0x400"
BR2_PACKAGE_BTOP=y
BR2_PACKAGE_NETATOP=y
```

## br2-scratchOS/package/applications/template-cpp/src/main/cpp/Config.in
```kconfig
    config BR2_PACKAGE_HELLOWORLD
    bool "helloworld"
	depends on BR2_HOST_GCC_AT_LEAST_11 # C++17
	depends on BR2_TOOLCHAIN_GCC_AT_LEAST_11 # C++17
	depends on BR2_INSTALL_LIBSTDCPP
	depends on BR2_TOOLCHAIN_HAS_THREADS
	depends on BR2_TOOLCHAIN_HAS_ATOMIC
    help
        Hello world component.
```

## br2-scratchOS/package/applications/template-py/src/main/py/Config.in
```kconfig
config BR2_PACKAGE_SUPERVISOR
	bool "supervisor"
	depends on BR2_PACKAGE_PYTHON3
	select BR2_PACKAGE_PYTHON_SETUPTOOLS # runtime dependency
	help
	  A ...

comment "supervisor needs a python interpreter"
	depends on !BR2_PACKAGE_PYTHON3
```

## br2-scratchOS/package/model/Config.in
```kconfig
config BR2_PACKAGE_MODEL
    bool "Model"
    help
        Model main package sources.

        https://tbd.acme

if BR2_PACKAGE_MODEL

config BR2_PACKAGE_MODEL_TEST
    bool "Model unit Test"
    default "Hello World!\n"
    help
        Model main package sources.

        https://tbd.acme

endif

if BR2_PACKAGE_MODEL

config BR2_PACKAGE_MODEL_INTEGRATION_TEST
    bool "Model Integration  Test"
    default "Hello World!\n"
    help
        Model main package sources.

        https://tbd.acme

endif
```
